## firmware/esp-idf-leds/main/Kconfig.projbuild
```kconfig
menu "TV LED receiver"
config TV_LEDS_STANDALONE_TEST
    bool "Write dim green once, then hold data low without USB input"
    default n
endmenu
```

## firmware/esp-idf-leds/sdkconfig.defaults
```kconfig
CONFIG_IDF_TARGET="esp32s3"
CONFIG_ESPTOOLPY_FLASHSIZE_4MB=y
CONFIG_ESP_CONSOLE_UART_DEFAULT=y
CONFIG_ESP_CONSOLE_SECONDARY_NONE=y
CONFIG_RMT_ISR_IRAM_SAFE=y
CONFIG_FREERTOS_HZ=1000
```
